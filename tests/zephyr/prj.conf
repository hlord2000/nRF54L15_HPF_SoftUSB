## CMakeLists.txt
```
cmake_minimum_required(VERSION 3.20.0)
find_package(Zephyr REQUIRED HINTS $ENV{ZEPHYR_BASE})
project(softusb_host_tests LANGUAGES C)

target_include_directories(app PRIVATE ../../common)
target_compile_definitions(app PRIVATE SOFTUSB_ZTEST=1)
target_sources(app PRIVATE
  src/main.c
  ../test_softusb.c
  ../../common/softusb.c
  ../../common/softusb_device.c
)
```

## prj.conf
```kconfig
CONFIG_ZTEST=y
# The shared host suite holds max FS packets and line buffers on the stack.
CONFIG_ZTEST_STACK_SIZE=65536
```

## src/main.c
```c
#include <zephyr/ztest.h>

/* These are the same assertion bodies used by the plain native/sanitizer runner. */
void softusb_test_codec(void);
void softusb_test_transactions(void);

ZTEST(softusb_portable, test_codec)
{
    softusb_test_codec();
}
ZTEST(softusb_portable, test_transactions)
{
    softusb_test_transactions();
}
ZTEST_SUITE(softusb_portable, NULL, NULL, NULL, NULL, NULL);
```
